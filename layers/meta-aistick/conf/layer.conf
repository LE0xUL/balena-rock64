## layers/meta-aistick/conf/layer.conf
```bitbake
# We have a conf and classes directory, add to BBPATH
BBPATH .= ":${LAYERDIR}"

# We have a packages directory, add to BBFILES
BBFILES += "${LAYERDIR}/recipes-*/*/*.bb \
            ${LAYERDIR}/recipes-*/*/*.bbappend"

BBFILE_COLLECTIONS += "aistick"
BBFILE_PATTERN_aistick := "^${LAYERDIR}/"
BBFILE_PRIORITY_aistick = "6"

LAYERSERIES_COMPAT_aistick = "warrior"
```

## layers/meta-balena-rock64/conf/layer.conf
```bitbake
BBPATH .= ":${LAYERDIR}"

BBFILES += "${LAYERDIR}/recipes-*/*/*.bb \
            ${LAYERDIR}/recipes-*/*/*.bbappend"

BBFILE_COLLECTIONS += "balena-rock64"
BBFILE_PATTERN_balena-rock64 := "^${LAYERDIR}/"
BBFILE_PRIORITY_balena-rock64 = "1337"

LAYERSERIES_COMPAT_balena-rock64 = "thud"
```
